## fs/dedupfs/Kconfig
```kconfig
config DEDUPFS
	tristate "Dedup fs support"
	depends on CRYPTO_HASH
	help
	  DedupFS is a filesystem based on dedupfs with block deduplication.

	  To compile this file system support as a module, choose M here: the
	  module will be called dedupfs.

	  If unsure, say Y.
```
